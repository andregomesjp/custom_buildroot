## configs/nucleus_rpi3final_defconfig
```kconfig
BR2_arm=y
BR2_cortex_a7=y
BR2_ARM_FPU_NEON_VFPV4=y
BR2_DL_DIR="$(HOME)/dl"
BR2_CCACHE=y
BR2_TOOLCHAIN_BUILDROOT_GLIBC=y
BR2_KERNEL_HEADERS_4_14=y
BR2_BINUTILS_VERSION_2_30_X=y
BR2_GCC_VERSION_8_X=y
BR2_TOOLCHAIN_BUILDROOT_CXX=y
BR2_INIT_SYSTEMD=y
BR2_ROOTFS_DEVICE_CREATION_DYNAMIC_EUDEV=y
BR2_TARGET_GENERIC_ROOT_PASSWD="zaitt2018"
BR2_SYSTEM_DHCP="eth0"
BR2_TARGET_TZ_INFO=y
BR2_TARGET_LOCALTIME="EST5EDT"
BR2_ROOTFS_OVERLAY="board/nucleus/rpi3/rootfs_overlay"
BR2_ROOTFS_POST_BUILD_SCRIPT="board/nucleus/rpi3/post-build.sh"
BR2_ROOTFS_POST_IMAGE_SCRIPT="board/nucleus/rpi3/post-image.sh"

BR2_LINUX_KERNEL=y
BR2_LINUX_KERNEL_CUSTOM_GIT=y
BR2_LINUX_KERNEL_CUSTOM_REPO_URL="https://github.com/raspberrypi/linux.git"
BR2_LINUX_KERNEL_CUSTOM_REPO_VERSION="1fa25792a2e83012e91de333034b9c9033adc1c3"
BR2_LINUX_KERNEL_DEFCONFIG="bcm2709"
BR2_LINUX_KERNEL_DTS_SUPPORT=y
BR2_LINUX_KERNEL_INTREE_DTS_NAME="bcm2709-rpi-2-b bcm2710-rpi-3-b bcm2710-rpi-3-b-plus bcm2710-rpi-cm3"
BR2_LINUX_KERNEL_DTS_OVERLAYS_SUPPORT=y

CONFIG_W1=y
CONFIG_W1_MASTER_GPIO=y
CONFIG_W1_SLAVE_THERM=y

BR2_PACKAGE_SERIALECHO=y
BR2_PACKAGE_GETTEXT=y
BR2_PACKAGE_BASH_COMPLETION=y
BR2_PACKAGE_LIBERATION=y
BR2_PACKAGE_FBSET=y
BR2_PACKAGE_FBV=y
BR2_PACKAGE_OPENSSL=y
BR2_PACKAGE_LIBOPENSSL=y
BR2_PACKAGE_LIBOPENSSL_BIN=y
BR2_PACKAGE_LIBOPENSSL_ENGINES=y
#BR2_PACKAGE_LIBRESSL is not set
BR2_PACKAGE_HAS_OPENSSL=y
BR2_PACKAGE_PROVIDES_OPENSSL="libopenssl"
BR2_PACKAGE_PROVIDES_HOST_OPENSSL="host-libopenssl"
BR2_PACKAGE_QT5=y
BR2_PACKAGE_QT5_VERSION_LATEST=y
BR2_PACKAGE_QT5BASE=y
BR2_PACKAGE_QT5BASE_CUSTOM_CONF_OPTS=""
BR2_PACKAGE_QT5BASE_CONFIG_FILE=""
BR2_PACKAGE_QT5BASE_XML=y
BR2_PACKAGE_QT5BASE_DBUS=y
BR2_PACKAGE_QT5SERIALBUS=y
BR2_PACKAGE_QT5SERIALPORT=y
BR2_PACKAGE_QT5WEBSOCKETS=y
BR2_PACKAGE_QT5BASE_NETWORK=y
BR2_PACKAGE_QT5BASE_OPENSSL=y
BR2_PACKAGE_DBUS=y
BR2_PACKAGE_DBUS_GLIB=y
BR2_PACKAGE_DBUS_PYTHON=y
BR2_PACKAGE_PROVIDES_UDEV="systemd"
BR2_PACKAGE_RPI_FIRMWARE=y
BR2_PACKAGE_RPI_FIRMWARE_X=y
BR2_PACKAGE_RPI_FIRMWARE_INSTALL_VCDBG=y
BR2_PACKAGE_RPI_WIFI_FIRMWARE=y
BR2_PACKAGE_I2C_TOOLS=y
BR2_PACKAGE_PYTHON3=y
BR2_PACKAGE_PYTHON3_SQLITE=y
BR2_PACKAGE_PYTHON_ALSAAUDIO=y
BR2_PACKAGE_PYTHON_CERTIFI=y
BR2_PACKAGE_PYTHON_CHARDET=y
BR2_PACKAGE_PYTHON_CLICK=y
BR2_PACKAGE_PYTHON_GOBJECT=y
BR2_PACKAGE_PYTHON_HPACK=y
BR2_PACKAGE_PYTHON_IDNA=y
BR2_PACKAGE_PYTHON_PYOPENSSL=y
BR2_PACKAGE_PYTHON_REQUESTS=y
BR2_PACKAGE_PYTHON_GTTS=y
BR2_PACKAGE_PYTHON_GTTS_TOKEN=y
BR2_PACKAGE_PYTHON_BS4=y
BR2_PACKAGE_PYTHON_BEAUTIFULSOUP4=y
BR2_PACKAGE_PYTHON_W1THERMSENSOR=y
BR2_PACKAGE_PYTHON_SETUPTOOLS=y
BR2_PACKAGE_PYTHON_SIX=y
BR2_PACKAGE_PYTHON_URLLIB3=y
BR2_PACKAGE_PYTHON_WIRINGPI=y
### OPENCV ###
BR2_PACKAGE_PYTHON3=y
BR2_PACKAGE_PYTHON_OPENCV_HOME_CAM=y
BR2_PACKAGE_PYTHON_OPENCV_HOME_CAM_SIMPLE_MOTION_DETECTOR=y
BR2_PACKAGE_PYTHON_OPENCV_HOME_CAM_SEND_EMAIL_ACTION=y
BR2_PACKAGE_PYTHON_SETUPTOOLS=y
BR2_PACKAGE_CA_CERTIFICATES=y
BR2_PACKAGE_OPENCV3=y
BR2_PACKAGE_OPENCV3_LIB_OBJDETECT=y
BR2_PACKAGE_OPENCV3_LIB_PYTHON=y
BR2_PACKAGE_OPENCV3_LIB_VIDEOIO=y
BR2_PACKAGE_OPENCV3_WITH_FFMPEG=y
BR2_PACKAGE_OPENCV3_WITH_JPEG=y
BR2_PACKAGE_OPENCV3_WITH_V4L=y
BR2_PACKAGE_PYTHON_IMUTILS=y
### OPENCV END ###
BR2_PACKAGE_LIBEVDEV=y
BR2_PACKAGE_IPERF3=y
BR2_PACKAGE_IPROUTE2=y
BR2_PACKAGE_IPTABLES=y
BR2_PACKAGE_IW=y
BR2_PACKAGE_NTP=y
BR2_PACKAGE_OPENSSH=y
BR2_PACKAGE_WPA_SUPPLICANT=y
BR2_PACKAGE_WPA_SUPPLICANT_AP_SUPPORT=y
BR2_PACKAGE_WPA_SUPPLICANT_WIFI_DISPLAY=y
BR2_PACKAGE_BASH=y
BR2_PACKAGE_PROCPS_NG=y
BR2_PACKAGE_ALSA_LIB=y
BR2_PACKAGE_ALSA_LIB_MIXER=y
BR2_PACKAGE_ALSA_LIB_RAWMIDI=y
BR2_PACKAGE_ALSA_LIB_PCM=y
BR2_PACKAGE_ALSA_LIB_SEQ=y
BR2_PACKAGE_AUDIOFILE=y
BR2_PACKAGE_ALSA_UTILS=y
BR2_PACKAGE_ALSA_UTILS_ALSACONF=y
BR2_PACKAGE_ALSA_UTILS_ACONNECT=y
BR2_PACKAGE_ALSA_UTILS_ALSACTL=y
BR2_PACKAGE_ALSA_UTILS_ALSALOOP=y
BR2_PACKAGE_ALSA_UTILS_ALSAMIXER=y
BR2_PACKAGE_ALSA_UTILS_ARECORDMIDI=y
BR2_PACKAGE_ALSA_UTILS_ASEQDUMP=y
BR2_PACKAGE_ALSA_UTILS_ASEQNET=y
BR2_PACKAGE_ALSA_UTILS_BAT=y
BR2_PACKAGE_ALSA_UTILS_IECSET=y
BR2_PACKAGE_ALSA_UTILS_SPEAKER_TEST=y
BR2_PACKAGE_ALSA_UTILS_ALSAUCM=y
BR2_PACKAGE_ALSA_UTILS_ALSATPLG=y
BR2_PACKAGE_ALSA_UTILS_AMIDI=y
BR2_PACKAGE_ALSA_UTILS_AMIXER=y
BR2_PACKAGE_ALSA_UTILS_APLAY=y
BR2_PACKAGE_ALSA_UTILS_APLAYMIDI=y
BR2_PACKAGE_MPG123=y
BR2_PACKAGE_JANSSON=y
BR2_PACKAGE_NANO=y
BR2_PACKAGE_NANO_TINY=y
# BR2_PACKAGE_VIM_RUNTIME is not set
BR2_TARGET_ROOTFS_EXT2=y
BR2_TARGET_ROOTFS_EXT2_4=y
BR2_TARGET_ROOTFS_EXT2_SIZE="900M"
BR2_TARGET_ROOTFS_EXT2_MKFS_OPTIONS="-O 64bit"
# BR2_TARGET_ROOTFS_TAR is not set
BR2_PACKAGE_HOST_DOSFSTOOLS=y
BR2_PACKAGE_HOST_GENIMAGE=y
BR2_PACKAGE_HOST_MTOOLS=y
```

## package/aiorosplayer/Config.in
```kconfig
config BR2_PACKAGE_AIOROSPLAYER
	bool "aiorosplayer"
	select BR2_PACKAGE_DBUS-PYTHON
	select BR2_PACKAGE_GTTS
	help
		TODO
```

## package/mcp3008-poll/Config.in
```kconfig
config BR2_PACKAGE_MCP3008_POLL
        bool "mcp3008-poll"
        help
          Command line app for testing MCP3008 ADCs. 

          https://github.com/scottellis/mcp3008-poll
```

## package/mcp3008-speedtest/Config.in
```kconfig
config BR2_PACKAGE_MCP3008_SPEEDTEST
        bool "mcp3008-speedtest"
        help
          Command line app for testing MCP3008 ADCs using spidev. 

          https://github.com/scottellis/mcp3008-speedtest
```

## package/natasha/Config.in
```kconfig
config BR2_PACKAGE_NATASHA
	bool "natasha"
	select BR2_PACKAGE_QT5
	select BR2_PACKAGE_QT5BASE_DBUS
	help
		TODO
```

## package/python-beautifulsoup4/Config.in
```kconfig
config BR2_PACKAGE_PYTHON_BEAUTIFULSOUP4
	bool "python-beautifulsoup4"
	help
	  Screen-scraping library.

	  http://www.crummy.com/software/BeautifulSoup/bs4/
```

## package/python-click/Config.in
```kconfig
config BR2_PACKAGE_PYTHON_CLICK
	bool "python-click"
	help
	  A simple wrapper around optparse for powerful command line
	  utilities.

	  http://github.com/mitsuhiko/click
```

## package/python-requests/Config.in
```kconfig
config BR2_PACKAGE_PYTHON_REQUESTS
	bool "python-requests"
	select BR2_PACKAGE_PYTHON_CHARDET # runtime
	select BR2_PACKAGE_PYTHON_IDNA # runtime
	select BR2_PACKAGE_PYTHON_URLLIB3 # runtime
	select BR2_PACKAGE_PYTHON_CERTIFI # runtime
	help
	  Python HTTP for Humans.

	  http://python-requests.org
```

## package/python-six/Config.in
```kconfig
config BR2_PACKAGE_PYTHON_SIX
	bool "python-six"
	help
	  Python 2 and 3 compatibility utilities.

	  http://pypi.python.org/pypi/six/
```

## package/python-w1thermsensor/Config.in
```kconfig
config BR2_PACKAGE_PYTHON_W1THERMSENSOR
	bool "python-w1thermsensor"
	select BR2_PACKAGE_PYTHON_CLICK # runtime
	help
	  This little pure python module provides a single class to
	  get the temperature of a w1 sensor.

	  http://github.com/timofurrer/w1thermsensor
```

## package/python-wiringpi/Config.in
```kconfig
config BR2_PACKAGE_PYTHON_WIRINGPI
	bool "python-wiringpi"
	help
	  A python interface to WiringPi 2.0 library which allows for
	  easily interfacing with the GPIO pins of the Raspberry Pi.
	  Also supports i2c and SPI.

	  https://github.com/WiringPi/WiringPi-Python/
```

## package/pytouch/Config.in
```kconfig
config BR2_PACKAGE_PYTOUCH
        bool "pytouch"
        depends on BR2_PACKAGE_PYTHON_PYQT5
        help
          Simple PyQt5 touchscreen test application
```

## package/sentinel/Config.in
```kconfig
config BR2_PACKAGE_SENTINEL
	bool "sentinel"
	select BR2_PACKAGE_QT5
	select BR2_PACKAGE_QT5BASE_DBUS
	depends on BR2_PACKAGE_JANSSON
	select BR2_PACKAGE_WIRINGPI
	help
		TODO
```

## package/serialecho/Config.in
```kconfig
config BR2_PACKAGE_SERIALECHO
        bool "serialecho"
        help
          Command line serial port test application.

          https://jumpnowtek.com
```

## package/tspress/Config.in
```kconfig
config BR2_PACKAGE_TSPRESS
        bool "tspress"
        depends on BR2_PACKAGE_QT5
        select BR2_PACKAGE_QT5BASE_WIDGETS
        help
          Qt5 widgets touchscreen test application.

          https://jumpnowtek.com
```
